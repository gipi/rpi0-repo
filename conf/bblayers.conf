## conf/bblayers.conf
```bitbake
# POKY_BBLAYERS_CONF_VERSION is increased each time build/conf/bblayers.conf
# changes incompatibly
POKY_BBLAYERS_CONF_VERSION = "2"

BBPATH = "${TOPDIR}"
BBFILES ?= ""

LAYER_PATH = "/hack/rpi-repo/sources"

BBLAYERS ?= " \
    ${LAYER_PATH}/meta \
    ${LAYER_PATH}/meta-poky \
    ${LAYER_PATH}/meta-openembedded/meta-oe \
    ${LAYER_PATH}/meta-openembedded/meta-multimedia \
    ${LAYER_PATH}/meta-openembedded/meta-networking \
    ${LAYER_PATH}/meta-openembedded/meta-perl \
    ${LAYER_PATH}/meta-openembedded/meta-python \
    ${LAYER_PATH}/meta-qt5 \
    ${LAYER_PATH}/meta-raspberrypi \
"
```

## conf/local.conf
```bitbake
# Local configuration for meta-rpi images
# Yocto Project 2.4 Poky distribution [rocko] branch
# This is a sysvinit system

LICENSE_FLAGS_WHITELIST = "commercial"

DISTRO_FEATURES = "ext2 pam opengl usbhost ${DISTRO_FEATURES_LIBC}"
DISTRO_FEATURES_append = " x11 wifi"

DISTRO_FEATURES_BACKFILL_CONSIDERED += "pulseaudio"

PREFERRED_PROVIDER_jpeg = "libjpeg-turbo"
PREFERRED_PROVIDER_jpeg-native = "libjpeg-turbo-native"

PREFERRED_PROVIDER_udev = "eudev"
VIRTUAL-RUNTIME_init_manager = "sysvinit"

PREFERRED_PROVIDER_virtual/bootloader = "u-boot"

MACHINE_FEATURES_remove = "apm"

IMAGE_FSTYPES = "wic wic.bmap tar.xz rpi-sdimg"
#IMAGE_LINGUAS_append = " it-it"
IMAGE_INSTALL_append = " keymaps"
IMAGE_INSTALL_append = " kbd-keymaps"
#IMAGE_INSTALL_append = " kiosk"
#IMAGE_INSTALL_append = " anet-scanner"
IMAGE_INSTALL_append = " wiringpi"

# the default is still 4.9
#PREFERRED_VERSION_linux-raspberrypi = "4.14.%"

# Choose the board you are building for
#MACHINE="raspberrypi"
MACHINE="raspberrypi0"
#MACHINE="raspberrypi0-wifi"
#MACHINE="raspberrypi2"
#MACHINE = "raspberrypi3"
#MACHINE="raspberrypi-cm"
#MACHINE="raspberrypi-cm3"

# Choices are Image or zImage if NOT using u-boot (no u-boot is the default)
# Choices are uImage or zImage if using u-boot, though if you choose zImage
# with u-boot you will also have to change the boot script boot command
KERNEL_IMAGETYPE = "zImage"
KERNEL_BOOTCMD = "bootz"
CMDLINE_append = " console=tty0"
ENABLE_UART="1"

DL_DIR = "/hack/yocto/oe-sources"

#SSTATE_DIR = "/oe4/rpi/sstate-cache"

#TMPDIR = "/oe4/rpi/tmp-rocko"

DISTRO = "poky"

PACKAGE_CLASSES = "package_ipk"

# i686 or x86_64
SDKMACHINE = "x86_64"
# https://wiki.yoctoproject.org/wiki/TipsAndTricks/Cmake,Eclipse,_and_SDKS
TOOLCHAIN_HOST_TASK_append = "${SDK_EXTRA_TOOLS}" 
SDK_EXTRA_TOOLS = " nativesdk-cmake    nativesdk-cmake-dev "

#EXTRA_IMAGE_FEATURES = "debug-tweaks"
INHERIT += "extrausers"
EXTRA_USERS_PARAMS = "usermod -P toor root; "

USER_CLASSES = "image-mklibs image-prelink"

RPI_USE_U_BOOT = "1"

PATCHRESOLVE = "noop"

RM_OLD_IMAGE = "1"

INHERIT += "rm_work"

CONF_VERSION = "1"

# https://wiki.yoctoproject.org/wiki/How_do_I
IMAGE_FEATURES += "package-management"

RPI_EXTRA_CONFIG = ' \n \
    # activate JTAG related pins \n \
    gpio=24,25,26,27=a4 \n \
    '
```
